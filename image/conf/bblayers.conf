## image/conf/bblayers.conf
```bitbake
# POKY_BBLAYERS_CONF_VERSION is increased each time build/conf/bblayers.conf
# changes incompatibly
POKY_BBLAYERS_CONF_VERSION = "2"

BBPATH = "${TOPDIR}"
BBFILES ?= ""

BBLAYERS ?= " \
  /home/tom/poky/meta \
  /home/tom/poky/meta-poky \
  /home/tom/poky/meta-yocto-bsp \
  /home/tom/layers/meta-odroid \
  "
```

## work/conf/bblayers.conf
```bitbake
# POKY_BBLAYERS_CONF_VERSION is increased each time build/conf/bblayers.conf
# changes incompatibly
POKY_BBLAYERS_CONF_VERSION = "2"

BBPATH = "${TOPDIR}"
BBFILES ?= ""

BBLAYERS ?= " \
  /home/tom/layers/poky/meta \
  /home/tom/layers/poky/meta-poky \
  /home/tom/layers/poky/meta-yocto-bsp \
  /home/tom/layers/meta-openembedded/meta-oe \
  /home/tom/layers/meta-openembedded/meta-filesystems \
  /home/tom/layers/meta-openembedded/meta-python \
  /home/tom/layers/meta-openembedded/meta-networking \
  /home/tom/layers/meta-openembedded/meta-perl \
  /home/tom/layers/meta-virtualization \
  /home/tom/layers/meta-security \
  /home/tom/layers/meta-thomux \
  "
```
